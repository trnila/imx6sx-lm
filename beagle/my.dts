/dts-v1/;
/plugin/;

/ {
    compatible = "ti,beaglebone", "ti,beaglebone-black";

    fragment@0 {
        target-path = "/";
        __overlay__ {
            chosen {
                bootargs = "console=ttyS0,115200 root=/dev/mmcblk0p2 rw rootwait";
                stdout-path = "serial0:115200n8";
            };
        };
    };
};