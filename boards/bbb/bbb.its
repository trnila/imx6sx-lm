## boards/bbb/bbb.its
```
/dts-v1/;

/ {
	description = "BeagleBone Black FIT Image";

	images {
		kernel {
			description = "Linux Kernel";
			data = /incbin/("../../out/bbb/linux/arch/arm/boot/zImage");
			type = "kernel";
			arch = "arm";
			os = "linux";
			compression = "none";
			load = <0x80008000>;
			entry = <0x80008000>;
		};

		fdt {
			description = "Device Tree";
			data = /incbin/("../../out/bbb/linux/arch/arm/boot/dts/ti/omap/am335x-boneblack-wireless.dtb");
			type = "flat_dt";
			arch = "arm";
			compression = "none";
		};

		bbb {
            data = /incbin/("../../out/bbb/bbb.dtbo");
            type = "flat_dt";
            arch = "arm";
            load = <0x87fc0000>;
        };
	};

	configurations {
		default = "conf";

		conf {
			kernel = "kernel";
			fdt = "fdt", "bbb";
		};
	};
};
```

## boards/stm32mp1/stm32mp1.its
```
/dts-v1/;

/ {
	description = "STM32MP1 FIT Image";

	images {
		kernel {
			description = "Linux Kernel";
			data = /incbin/("../../out/stm32mp1/linux/arch/arm/boot/zImage");
			type = "kernel";
			arch = "arm";
			os = "linux";
			compression = "none";
			load = <0xc2000000>;
			entry = <0xc2000000>;
		};

		fdt {
			description = "Device Tree";
			data = /incbin/("../../out/stm32mp1/linux/arch/arm/boot/dts/st/stm32mp157c-dk2.dtb");
			type = "flat_dt";
			arch = "arm";
			compression = "none";
			load = <0xc4000000>;
		};

		overlay {
            data = /incbin/("../../out/stm32mp1/overlay.dtbo");
            type = "flat_dt";
            arch = "arm";
            load = <0xc4300000>;
        };
	};

	configurations {
		default = "conf";

		conf {
			kernel = "kernel";
			fdt = "fdt", "overlay";
		};
	};
};
```
