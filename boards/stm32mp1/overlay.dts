/dts-v1/;
/plugin/;

/ {
    fragment@0 {
        target-path = "/";
        __overlay__ {
            chosen {
                bootargs = "console=ttySTM0,115200 root=/dev/mmcblk0p4 rw rootwait";
                stdout-path = "serial0:115200n8";
            };
        };
    };

    fragment@1 {
        target-path = "/soc/bus@5c007000/serial@40018000";
        __overlay__ {
            status = "okay";
        };
    };
};
